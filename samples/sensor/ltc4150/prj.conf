## CMakeLists.txt
```
#
#  Copyright (c) 2021 arithmetics.io
#
#  SPDX-License-Identifier: Apache-2.0

cmake_minimum_required(VERSION 3.20.0)
find_package(Zephyr HINTS $ENV{ZEPHYR_BASE})
project(ltc4150)

FILE(GLOB app_sources src/*.c)
target_sources(app PRIVATE ${app_sources})
```

## sample.yaml
```
sample:
  name: ltc4150 sample
  description: LTC4150 sample application
tests:
  sample.sensor.ltc4150:
    harness: sensor
    tags: sensors
    platform_allow: nrf52840_mdk
    integration_platforms:
      - nrf52840_mdk
```

## prj.conf
```kconfig
CONFIG_LOG=y
CONFIG_I2C=y
CONFIG_SENSOR=y
CONFIG_PM_DEVICE=n
CONFIG_NEWLIB_LIBC=y
CONFIG_NEWLIB_LIBC_FLOAT_PRINTF=y

CONFIG_LTC4150=y
```

## boards/nrf52840_mdk.overlay
```dts
/*
 * Copyright (c) 2021 arithmetics.io
 *
 * SPDX-License-Identifier: Apache-2.0
 */

ltc4150 {
	compatible = "adi,ltc4150";
	label = "LTC4150";
	int-gpios = <&gpio0 27 GPIO_ACTIVE_LOW>;
	pol-gpios = <&gpio0 26 GPIO_ACTIVE_HIGH>;
	shdn-gpios = <&gpio0 25 GPIO_ACTIVE_LOW>;
};
```

## boards/nrf9160dk_nrf9160.overlay
```dts
/*
 * Copyright (c) 2021 arithmetics.io
 *
 * SPDX-License-Identifier: Apache-2.0
 */

/ {
	ltc4150 {
		compatible = "adi,ltc4150";
		label = "LTC4150";
		int-gpios = <&gpio0 27 GPIO_ACTIVE_LOW>;
		pol-gpios = <&gpio0 26 GPIO_ACTIVE_HIGH>;
		shdn-gpios = <&gpio0 25 GPIO_ACTIVE_LOW>;

		shunt-resistance = <50>;
	};
};
```

## boards/nrf9160dk_nrf9160_0_14_0.overlay
```dts
/*
 * Copyright (c) 2021 arithmetics.io
 *
 * SPDX-License-Identifier: Apache-2.0
 */

/ {
	ltc4150 {
		compatible = "adi,ltc4150";
		label = "LTC4150";
		int-gpios = <&gpio0 28 GPIO_ACTIVE_LOW>;
		pol-gpios = <&gpio0 15 GPIO_ACTIVE_HIGH>;
		shdn-gpios = <&gpio0 16 GPIO_ACTIVE_LOW>;
		int-clr-gpios = <&gpio0 20 GPIO_ACTIVE_LOW>;

		shunt-resistance = <50>;
		design-capacity = <330>;
	};
};
```

## src/main.c
```c
/*
 * Copyright (c) 2021 arithmetics.io
 *
 * SPDX-License-Identifier: Apache-2.0
 */

#include <zephyr.h>
#include <device.h>
#include <sys/util.h>
#include <drivers/sensor.h>
#include <stdio.h>

K_SEM_DEFINE(sem, 0, 1);

static void trigger_handler(const struct device *dev,
			    struct sensor_trigger *trigger)
{
	switch (trigger->type) {
	case SENSOR_TRIG_DATA_READY:
		printk("INT - new count\n");
		k_sem_give(&sem);
		break;
	default:
		printk("Unknown trigger\n");
	}
}

#ifdef CONFIG_PM_DEVICE
static void pm_info(enum pm_device_state state, int status)
{
	ARG_UNUSED(dev);
	ARG_UNUSED(arg);

	switch (state) {
	case PM_DEVICE_STATE_ACTIVE:
		printk("Enter ACTIVE_STATE ");
		break;
	case PM_DEVICE_STATE_OFF:
		printk("Enter OFF_STATE ");
		break;
	}

	if (status) {
		printk("Fail\n");
	} else {
		printk("Success\n");
	}
}
#endif

#define DEVICE_NODE DT_COMPAT_GET_ANY_STATUS_OKAY(adi_ltc4150)

void main(void)
{
	struct sensor_value val;

	const struct device *dev = DEVICE_DT_GET(DEVICE_NODE);

	if (!device_is_ready(dev)) {
		printk("Device %s is not ready\n", dev->name);
		return;
	}

	struct sensor_trigger trig = {
		.type = SENSOR_TRIG_DATA_READY,
		.chan = SENSOR_CHAN_ALL,
	};

	if (sensor_trigger_set(dev, &trig, trigger_handler)) {
		printk("Could not set trigger\n");
		return;
	}

#ifdef CONFIG_PM_DEVICE
	/* Testing the power modes */
	enum pm_device_state p_state;
	int ret;

	p_state = PM_DEVICE_STATE_OFF;
	ret = pm_device_state_set(dev, p_state);
	pm_info(p_state, ret);

	p_state = PM_DEVICE_STATE_ACTIVE;
	ret = pm_device_state_set(dev, p_state);
	pm_info(p_state, ret);
#endif

	while (1) {
		k_sem_take(&sem, K_FOREVER);

		sensor_channel_get(dev, SENSOR_CHAN_GAUGE_COULOMB_COUNT, &val);
		printf("Coulomb count: %i\n", val.val1);
	}
}
```

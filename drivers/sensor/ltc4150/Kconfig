## drivers/sensor/ltc4150/Kconfig
```kconfig
# LTC4150 Coulomb Counter/Battery Gas Gauge

# Copyright (c) 2021 arithmetics.io
# SPDX-License-Identifier: Apache-2.0

menuconfig LTC4150
	bool "LTC4150 Coulomb Counter/Battery Gas Gauge"
	depends on GPIO && NEWLIB_LIBC
	help
	  Enable driver for LTC4150 Coulomb Counter/Battery Gas Gauge.
```

## dts/bindings/sensor/adi,ltc4150.yaml
```yaml
# Copyright (c) 2021 arithmetics.io
# SPDX-License-Identifier: Apache-2.0

description: Analog Devices LTC4150 Coulomb Counter/Battery Gas Gauge
compatible: "adi,ltc4150"

include: base.yaml

properties:
    int-gpios:
      type: phandle-array
      required: true
      description: |
        The INT (interrupt) pin defaults to active low when produced by the sensor.
        The property value should ensure the flags properly describe
        the signal that is presented to the driver.

    int-clr-gpios:
      type: phandle-array
      required: false
      description: |
        The CLEAR pin defaults to active low when consumed by the sensor.
        The property value should ensure the flags properly describe
        the signal that is presented to the driver.

    pol-gpios:
      type: phandle-array
      required: true
      description: |
        The POL (polarity) pin defaults to active high when consumed by the sensor.
        The property value should ensure the flags properly describe
        the signal that is presented to the driver.
    
    shdn-gpios:
      type: phandle-array
      required: false
      description: |
        The SHDN (shutdown) pin defaults to active low when consumed by the sensor.
        The property value should ensure the flags properly describe
        the signal that is presented to the driver.

    shunt-resistance:
        type: int
        required: true
        description: |
          Resistence of the shunt resistor in milliohms

    design-capacity:
        type: int
        required: true
        description: Battery Design Capacity in mAh
```

## dts/bindings/sensor/ti,bq35100.yaml
```yaml
# Copyright (c) 2021 arithmetics.io
# SPDX-License-Identifier: Apache-2.0

description: Texas Instruments BQ35100 lithium primary battery fuel gauge
compatible: "ti,bq35100"

include: i2c-device.yaml

properties:
    ge-gpios:
      type: phandle-array
      required: false
      description: |
        The Gauge Enable (GE) pin defaults to active high when consumed by the sensor.
        The property value should ensure the flags properly describe
        the signal that is presented to the driver.

    alert-gpios:
      type: phandle-array
      required: false
      description: |
        The ALERT pin defaults to active low when produced by the sensor.
        The property value should ensure the flags properly describe
        the signal that is presented to the driver.

    capacity:
      type: int
      required: true
      description: |
        The design capacity of the battery in mAh.

    gauge-mode:
      type: string
      required: true
      description: |
        The gauge mode the device in currently.
      enum:
        - "ACCUMULATOR"
        - "SOH"
        - "EOS"

    temp-sensor-src:
      type: int
      required: false
      default: 0
      description: |
        Whether to use internal or external temperature sensor for calculations.

        0 = Use external temperature sensor.
        1 = Use internal temperature sensor.
      enum:
        - 0
        - 1
```
